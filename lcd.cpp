#include "lcd.h"

#define BAR_NUMBER 6

static uint8_t lcd_bars[BAR_NUMBER][8] = 
{
  {0xFF,0x11,0x11,0x11,0x11,0x11,0x11,0xFF},
  {0xFF,0x11,0x11,0x11,0x11,0x11,0xFF,0xFF},
  {0xFF,0x11,0x11,0x11,0x11,0xFF,0xFF,0xFF},
  {0xFF,0x11,0x11,0x11,0xFF,0xFF,0xFF,0xFF},
  {0xFF,0x11,0xFF,0xFF,0xFF,0xFF,0xFF,0xFF},
  {0xFF,0xFF,0xFF,0xFF,0xFF,0xFF,0xFF,0xFF}
};

Lcd::Lcd(uint8_t address, int columns, int rows) : LiquidCrystal_I2C(address, columns, rows){}

void Lcd::init()
{
  LiquidCrystal_I2C:: init();
  for(int i = 0; i < BAR_NUMBER; i++)
  {
    createChar(i, lcd_bars[i]);
  }
}

void Lcd::printBar(float ratio)
{
  int size = ratio * (BAR_NUMBER);
  if (size < 0)
    size = 0;
  
  if (size >= BAR_NUMBER)
    print("!");
  else
    write((uint8_t)size);
}